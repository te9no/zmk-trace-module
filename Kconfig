## Kconfig
```kconfig
menuconfig ZMK_TRACE
    bool "ZMK trace JSONL telemetry"
    default n

if ZMK_TRACE

config ZMK_TRACE_USB_CDC
    bool "Emit trace over USB CDC/UART"
    default y

config ZMK_TRACE_INPUT_PROCESSOR
    bool "Enable trace input processor"
    default y

config ZMK_TRACE_BUFFER_SIZE
    int "Trace line buffer size"
    default 192

config ZMK_TRACE_MIN_INTERVAL_MS
    int "Minimum interval between trace lines"
    default 20
    help
      Drop trace lines emitted faster than this interval. Set to 0 to emit
      every line. This keeps high-rate pointing devices from blocking input
      processing while USB CDC trace output is enabled.

config ZMK_TRACE_QUEUE_SIZE
    int "Trace output queue size"
    default 16
    help
      Number of trace lines buffered before dropping new lines.

config ZMK_TRACE_THREAD_STACK_SIZE
    int "Trace output thread stack size"
    default 1024

config ZMK_TRACE_THREAD_PRIORITY
    int "Trace output thread priority"
    default 10

endif
```

## dts/bindings/input_processor/zmk,input-processor-trace.yaml
```yaml
description: Input Processor for emitting trace snapshots

compatible: "zmk,input-processor-trace"

include: ip_zero_param.yaml

properties:
  stage:
    type: string
    required: true
```
